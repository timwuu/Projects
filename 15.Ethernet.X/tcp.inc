;.equiv  TCP_fCWR, 0x80
;.equiv  TCP_fECE, 0x40
;.equiv  TCP_fURG, 0x20
;.equiv  TCP_fACK, 0x10
;.equiv  TCP_fPSH, 0x08
;.equiv  TCP_fRST, 0x04
;.equiv  TCP_fSYN, 0x02
;.equiv  TCP_fFIN, 0x01
;
.equiv  TCP_fCWR, 7
.equiv  TCP_fECE, 6
.equiv  TCP_fURG, 5
.equiv  TCP_fACK, 4
.equiv  TCP_fPSH, 3
.equiv  TCP_fRST, 2
.equiv  TCP_fSYN, 1
.equiv  TCP_fFIN, 0

.equiv TCP_sCLOSED, 0x00
.equiv TCP_sLISTEN, 0x01
.equiv TCP_sSYN_RCVD, 0x02
.equiv TCP_sSYN_SENT, 0x03
.equiv TCP_sEST,      0x04
.equiv TCP_sFIN_WAIT_1, 0x05
.equiv TCP_sCLOSING,    0x06
.equiv TCP_sTIMED_WAIT, 0x07
.equiv TCP_sSEND_RST,   0x08
.equiv TCP_sDATA_READY, 0x09
.equiv TCP_sLAST_ACK, 0x0A
.equiv TCP_sCLOSE,    0x0B
.equiv TCP_sINVALID,  0xFF

